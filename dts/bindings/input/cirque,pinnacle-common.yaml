## dts/bindings/input/cirque,pinnacle-common.yaml
```yaml
properties:
  dr-gpios:
    type: phandle-array
    description: Data ready pin for the trackpad
  rotate-90:
    type: boolean
  x-invert:
    type: boolean
  y-invert:
    type: boolean
  sleep:
    type: boolean
  no-secondary-tap:
    type: boolean
  no-taps:
    type: boolean
  sensitivity:
    type: string
    enum:
      - 1x
      - 2x
      - 3x
      - 4x
    description: ADC attenuation (sensitivity) setting.
  x-axis-z-min:
    type: int
    default: 5
  y-axis-z-min:
    type: int
    default: 4
  acceleration-mode:
    type: string
    enum:
      - NONE
      - HYBRID
      - SIGMOID
    description: Pointer acceleration mode.
  acceleration-factor:
    type: int
    default: 125
    description: Multiplier for sigmoid acceleration curve
  acceleration-threshold:
    type: int
    default: 900
    description: Movement threshold to start accelerating
  acceleration-exponent:
    type: int
    default: 200
    description: Acceleration curve exponent (curve smoothness)
```
